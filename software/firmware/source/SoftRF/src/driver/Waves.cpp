#if defined(ARDUINO)
#include <Arduino.h>
#endif

#if !defined(EXCLUDE_VOICE)
#if defined(ESP32)

#include "../../SoftRF.h"
#include "Voice.h"

#include "SPIFFS.h"
// #include <FS.h>

// C table generated from file: traffic.wav - sans header

#define DEFAULTSIZE 3470
const uint8_t defaultwav[DEFAULTSIZE] PROGMEM = {
126,131,125,130,131,127,127,133,125,128,131,127,131,
127,130,130,129,129,126,132,120,129,137,121,132,134,122,130,133,123,131,130,
120,140,123,121,141,126,119,140,121,106,133,128,125,133,132,129,124,150,95,
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127,128,128,127,127,129,127,127,128,128,127,128,128,128,127,127,129,127
};

// these will be offsets into the waves.tar file:
static uint32_t offsets[17] = {
    0,
    0,
    0,
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    0,
    0
};

// these will be the file sizes in the waves.tar file:
static int wavsize[17] = {
    0,
    0,
    0,
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    0,
    0
};

static const char *words[17] PROGMEM = {
    "traffic",
    "high",
    "low",
    "level",
    "danger",
    "nine",
    "ten",
    "eleven",
    "ahead",
    "one",
    "two",
    "three",
    "four",
    "five",
    "six",
    "seven",
    "eight",
};

// public
int num_wav_files = 0;

// public
void clear_waves()
{
    for (int i=0; i<17; i++) {
       offsets[i] = 0;
       wavsize[i] = 0;
    }
    num_wav_files = 0;
}

static uint32_t wordoffset = 0;
static int wordsize = 0;
static const uint8_t *defaultp = NULL;
static File tarfile;

// public
bool word2wav(const char *word) {

    if (wordoffset > 0)
        tarfile.close();
    wordoffset = 0;
    wordsize = 0;
    defaultp = NULL;

    if (num_wav_files == 0) {
        Serial.println("word2wav: no WAV files");
        defaultp = defaultwav;
        wordsize = DEFAULTSIZE;
        return false;
    }

    for (int i=0; i<17; i++) {
        if (strcmp(word,words[i])==0 && offsets[i] > 0) {
            tarfile = SPIFFS.open("/waves.tar", "r");
            if (!tarfile) {
                Serial.println(F("Failed to open waves.tar"));
                break;
            }
            uint32_t offset = offsets[i];
            if (! tarfile.seek(offset, SeekSet)) {
                Serial.println(F("Failed to fseek to wav position"));
                tarfile.close();
                break;
            }
            wordoffset = offset;
            wordsize = wavsize[i];
            Serial.printf("word2wav: '%s' found -> %d bytes\n", word, wordsize);
            return true;
        }
    }

    Serial.printf("word2wav: '%s' not found\n", word);
    defaultp = defaultwav;
    wordsize = DEFAULTSIZE;
    return false;
}

// public: read one byte from WAV file
//  - at EOF returns false
int read_wav_byte(uint8_t &data)
{
    int rval = 0;

    if (wordsize <= 0)
        return 0;

    if (defaultp != NULL) {   // playing the default built-in word
        data = *defaultp++;
        --wordsize;
        rval = -1;
    } else if (wordoffset > 0) {    // playing a file
        if (tarfile.available()) {
            data = tarfile.read();
            --wordsize;
            rval = 1;
        } else {
            wordsize = 0;
        }
    } else {
        wordsize = 0;
    }

    if (wordsize <= 0) {
        if (wordoffset > 0)
            tarfile.close();
        wordoffset = 0;
        wordsize = 0;
        defaultp = NULL;
    }

    return rval;
}


/**********************************************************/

// Code adapted from untar.c by Tim Kientzle:

/* Parse an octal number, ignoring leading and trailing nonsense. */
static int
parseoct(const char *p, size_t n)
{
    int i = 0;

    while ((*p < '0' || *p > '7') && n > 0) {
        ++p;
        --n;
    }
    while (*p >= '0' && *p <= '7' && n > 0) {
        i *= 8;
        i += *p - '0';
        ++p;
        --n;
    }
    return (i);
}

/* Returns true if this is 512 zero bytes. */
static int
is_end_of_archive(const char *p)
{
    int n;
    for (n = 511; n >= 0; --n)
        if (p[n] != '\0')
            return (0);
    return (1);
}

/* Verify the tar checksum. */
static int
verify_checksum(const char *p)
{
    int n, u = 0;
    for (n = 0; n < 512; ++n) {
        if (n < 148 || n > 155)
            /* Standard tar checksum adds unsigned bytes. */
            u += ((unsigned char *)p)[n];
        else
            u += 0x20;

    }
    return (u == parseoct(p + 148, 8));
}

typedef struct wavProperties_s {
    uint32_t chunkID;
    uint32_t chunkSize;
    uint16_t audioFormat;
    uint16_t numChannels;
    uint32_t sampleRate;
    uint32_t byteRate;
    uint16_t blockAlign;
    uint16_t bitsPerSample;
} wavProperties_t;

/* parse waves.tar in SPIFFS, store found offsets */
// public
int parse_wav_tar()
{
    char buff[512];
    char name[128];
    size_t bytes_read;
    uint32_t offset = 0;
    uint32_t filesize, foundfilesize, foundoffset;
    bool is_a_wav_file;

    clear_waves();

    if (!SPIFFS.begin(true)) {
        Serial.println(F("An Error has occurred while mounting SPIFFS"));
        return 0;
    }

    if (!SPIFFS.exists("/waves.tar")) {
        Serial.println(F("waves.tar not present in SPIFFS"));
        return 0;
    }

    File tarfile = SPIFFS.open("/waves.tar", "r");
    if (!tarfile) {
        Serial.println(F("Failed to open waves.tar"));
        return 0;
    }      

    Serial.println(F("Parsing waves.tar..."));

    while (true) {
        bytes_read = tarfile.read((uint8_t *)buff, 512);
        offset += 512;
        if (bytes_read < 512) {
            Serial.printf("Short read TAR header: got %d bytes\n",
                (int)bytes_read);
            tarfile.close();
            return num_wav_files;
        }
        if (is_end_of_archive(buff)) {
            Serial.printf("Found %d wav files\n", num_wav_files);
            tarfile.close();
            return num_wav_files;
        }
        if (!verify_checksum(buff)) {
            Serial.println(F("Checksum failure"));
            tarfile.close();
            return num_wav_files;
        }
        filesize = parseoct(buff + 124, 12);
        switch (buff[156]) {
        case '1':
        case '2':
        case '3':
        case '4':
        case '5':
        case '6':
            break;
        default:
            Serial.printf("... file %s ... ", buff);
            is_a_wav_file = true;
            strcpy(name,buff);
            char *p = strrchr(name,'.');
            // each file must be called something.wav
            if (p == NULL)
                is_a_wav_file = false;
            else if (strcmp(p+1,"wav") && strcmp(p+1,"WAV"))
                is_a_wav_file = false;
            else
                *p = '\0';     // drop the file extension
            if (offset != tarfile.position())
                Serial.println(F("Warning: offset != file position"));
            foundoffset = tarfile.position();
            foundfilesize = filesize;
            if (filesize < 1000 || filesize > 32000)   // these should be small files
                is_a_wav_file = false;
            if (is_a_wav_file == false)
                break;
            // read the first file block and examine the WAV header
            bytes_read = tarfile.read((uint8_t *)buff, 512);
            offset += 512;
            if (bytes_read < 512) {
                Serial.printf("Short read WAV header: got %d bytes\n",
                    (int)bytes_read);
                tarfile.close();
                return num_wav_files;
            }
            if (filesize < 512)
                bytes_read = filesize;
            filesize -= bytes_read;
            // must be mono 8-bit PCM file with sample rate 8000
            wavProperties_t *wp = (wavProperties_t *) &buff[12];
            if (wp->audioFormat != 1
            ||  wp->numChannels != 1
            ||  wp->sampleRate != 8000
            ||  wp->bitsPerSample != 8)
                is_a_wav_file = false;
            break;
        }
        // read through (and ignore) the rest of the WAV data
        while (filesize > 0) {
            bytes_read = tarfile.read((uint8_t *)buff, 512);
            offset += 512;
            if (bytes_read < 512) {
                Serial.printf("Short read WAV data: got %d bytes\n",
                    (int)bytes_read);
                tarfile.close();
                return num_wav_files;
            }
            if (filesize < 512)
                bytes_read = filesize;
            filesize -= bytes_read;
        }
        int i;
        if (is_a_wav_file) {
            for (i=0; i<17; i++) {
                if (strcmp(name,words[i])==0) {
                    Serial.println(F("matched"));
                    ++num_wav_files;
                    // skip WAV header and also drop last 40 bytes
                    wavsize[i] = (int) foundfilesize - 84;
                    offsets[i] = foundoffset + 44;
                    break;
                }
            }
            if (i==17)  // not found
                Serial.println(F("not matched"));
        }
    }
    tarfile.close();
    return num_wav_files;
}

/**********************************************************/

#endif
#endif
